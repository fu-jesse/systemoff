/*
 * Copyright (c) 2026 Nordic Semiconductor ASA
 *
 * SPDX-License-Identifier: LicenseRef-Nordic-5-Clause
 */

/* button0 (P1.13) is the System OFF wake-up pin; the DK overlays delete the buttons by default */
/ {
	buttons {
		compatible = "gpio-keys";

		button0: button_0 {
			gpios = <&gpio1 13 (GPIO_PULL_UP | GPIO_ACTIVE_LOW)>;
			label = "Push button 0";
			zephyr,code = <INPUT_KEY_0>;
		};
	};

	aliases {
		sw0 = &button0;
	};
};
