## CMakeLists.txt
```
# Copyright (c) 2026 Nordic Semiconductor ASA
#
# SPDX-License-Identifier: LicenseRef-Nordic-5-Clause

cmake_minimum_required(VERSION 3.20.0)

find_package(Zephyr REQUIRED HINTS $ENV{ZEPHYR_BASE})

project(system_off)

target_sources(app PRIVATE src/main.c)
if(CONFIG_APP_USE_RETAINED_MEM)
  target_sources(app PRIVATE src/retained.c)
endif()
```

## Kconfig
```
# Copyright (c) 2026 Nordic Semiconductor ASA
#
# SPDX-License-Identifier: LicenseRef-Nordic-5-Clause

mainmenu "System OFF sample"

config APP_USE_RETAINED_MEM
	bool "Keep a boot counter in retained RAM across System OFF"
	select RETAINED_MEM
	select CRC
	help
	  Use the retained_mem driver and the 4 KB retained region from
	  snippets/retram/<soc>.overlay. Build with the retram snippet (-S retram),
	  which adds the overlay for the board; the build fails in
	  src/retained.c without it. Without this option no RAM is retained in
	  System OFF and cpuapp gets all the RAM.

config APP_GRTC_WAKEUP_ENABLE
	bool "Use GRTC to wake up the device from System OFF"
	help
	  The low-frequency clock is the LFXO.

config APP_GRTC_WAKEUP_SECONDS
	int "GRTC wake-up time in seconds"
	default 10
	depends on APP_GRTC_WAKEUP_ENABLE

config APP_SYS_CLOCK_DISABLE
	bool "Disable the system clock (GRTC and LF clock) right before System OFF"
	depends on SYSTEM_TIMER_HAS_DISABLE_SUPPORT && !APP_GRTC_WAKEUP_ENABLE
	default y
	help
	  Calls sys_clock_disable() just before entering System OFF. Saves a little
	  current, but GRTC no longer runs, so it cannot be combined with the GRTC
	  wake-up. Nothing may log or use kernel timeouts after the call.

config APP_GPIO_WAKEUP_ENABLE
	bool "Use sw0 to wake up the device from System OFF"
	depends on $(dt_alias_enabled,sw0)
	select GPIO
	help
	  Off by default; the pinwake snippet turns it on.

config APP_GPIO_RELEASE_TIMEOUT_MS
	int "Time to wait for sw0 to be released before entering System OFF, in ms"
	default 5000
	depends on APP_GPIO_WAKEUP_ENABLE
	help
	  A level-active wake-up fires at once while the button is held. If the button
	  is still pressed after this time, System OFF is entered without the sw0
	  wake-up (a warning is logged).

source "Kconfig.zephyr"
```

## sample.yaml
```
sample:
  description: enter System OFF on every boot, with optional GRTC / GPIO wake-up and retained RAM
  name: system_off
common:
  sysbuild: true
  build_only: true
  tags: system_off
  platform_allow:
    - nrf54l15dk/nrf54l15/cpuapp
    - nrf54lm20dk/nrf54lm20a/cpuapp
    - nrf54lm20dk/nrf54lm20b/cpuapp
    - nrf54ls05dk/nrf54ls05a/cpuapp
    - nrf54ls05dk/nrf54ls05b/cpuapp
tests:
  # name: sample.system_off[.log].<pin|grtc|ret>   (the LF clock is always the LFXO)
  #   .log  : prj.conf, log on uart20      no .log : FILE_SUFFIX=release, no log, uart20 disabled
  #           (the release scenarios have no log part in the name, which keeps the build path short)
  #   The modes are snippets (snippets/), so twister needs the application directory as a snippet root:
  #     twister ... --extra-args SNIPPET_ROOT=<this directory>
  #   pin   : pinwake snippet: sw0 wake-up, system clock (GRTC, LF clock) disabled before System OFF
  #           (Kconfig default APP_SYS_CLOCK_DISABLE)
  #   grtc  : grtcwake snippet: GRTC wake-up
  #   ret   : pinwake + retram snippets: sw0 wake-up, 4 KB retained RAM; the retram snippet adds
  #           snippets/retram/<soc>.overlay for the board, which carves the region out of the SRAM, so the
  #           other builds give cpuapp all the RAM
  sample.system_off.log.pin:
    tags: system_off
    required_snippets:
      - pinwake
  sample.system_off.log.grtc:
    required_snippets:
      - grtcwake
  sample.system_off.log.ret:
    required_snippets:
      - pinwake
      - retram
  sample.system_off.pin:
    tags: system_off
    extra_args: FILE_SUFFIX=release
    required_snippets:
      - pinwake
  sample.system_off.grtc:
    extra_args: FILE_SUFFIX=release
    required_snippets:
      - grtcwake
  sample.system_off.ret:
    extra_args: FILE_SUFFIX=release
    required_snippets:
      - pinwake
      - retram
```

## prj.conf
```kconfig
# Copyright (c) 2026 Nordic Semiconductor ASA
#
# SPDX-License-Identifier: LicenseRef-Nordic-5-Clause

CONFIG_LOG=y
CONFIG_SERIAL=y
CONFIG_UART_CONSOLE=y
CONFIG_LOG_BACKEND_UART=y
# Print synchronously so the output is out before the device powers off.
CONFIG_LOG_MODE_IMMEDIATE=y
CONFIG_PM_DEVICE=y
CONFIG_PM_DEVICE_RUNTIME=y
CONFIG_POWEROFF=y
CONFIG_HWINFO=y

# Deprecated symbol, replaced by SOC_SERIES_NRF54L
CONFIG_NRF_PLATFORM_LUMOS=n
```

## prj_release.conf
```kconfig
# Copyright (c) 2026 Nordic Semiconductor ASA
#
# SPDX-License-Identifier: LicenseRef-Nordic-5-Clause

CONFIG_LOG=n
CONFIG_SERIAL=n
CONFIG_HWINFO=n
CONFIG_PM_DEVICE=y
CONFIG_PM_DEVICE_RUNTIME=y
CONFIG_POWEROFF=y

# Board defaults select the UART console; there is no serial driver in release
CONFIG_UART_CONSOLE=n

# Deprecated symbol, replaced by SOC_SERIES_NRF54L
CONFIG_NRF_PLATFORM_LUMOS=n
```

## app_release.overlay
```dts
/*
 * Copyright (c) 2026 Nordic Semiconductor ASA
 *
 * SPDX-License-Identifier: LicenseRef-Nordic-5-Clause
 */

/* Release: disable the console/log UART */
&uart20 {
	status = "disabled";
};
```

## boards/dk_common.overlay
```dts
/*
 * Copyright (c) 2026 Nordic Semiconductor ASA
 *
 * SPDX-License-Identifier: LicenseRef-Nordic-5-Clause
 */

/* Common to all DKs: remove LEDs, buttons and PWM, suspend uart20 at boot.
 * The buttons (and the sw0 alias) are deleted; the pinwake snippet adds button0 back as the
 * GPIO wake-up source.
 */

/ {
	/delete-node/ leds;
	/delete-node/ pwmleds;
	/delete-node/ buttons;

	aliases {
		/delete-property/ led0;
		/delete-property/ led1;
		/delete-property/ led2;
		/delete-property/ led3;
		/delete-property/ pwm-led0;
		/delete-property/ sw0;
		/delete-property/ sw1;
		/delete-property/ sw2;
		/delete-property/ sw3;
		/delete-property/ mcuboot-button0;
		/delete-property/ mcuboot-led0;
	};
};

/* PWM is not used (pwmleds removed above) */
&pwm20 {
	status = "disabled";
};

/* Suspend uart20 at boot; the log backend resumes it only while printing */
&uart20 {
	zephyr,pm-device-runtime-auto;
};
```

## boards/dk_l15_lm20_common.overlay
```dts
/*
 * Copyright (c) 2026 Nordic Semiconductor ASA
 *
 * SPDX-License-Identifier: LicenseRef-Nordic-5-Clause
 */

/* nRF54L15 and nRF54LM20 DKs (nRF54LS05 has none of these nodes) */

#include "dk_common.overlay"

/* Remove the external SPI flash */
/delete-node/ &mx25r64;

/* No SPI/I2C devices in use */
&spi00 {
	status = "disabled";
};

/* Use NFC pins as regular GPIOs */
&nfct {
	status = "disabled";
	nfct-pins-as-gpios;
};
```

## boards/nrf54l15dk_nrf54l15_cpuapp.overlay
```dts
/*
 * Copyright (c) 2026 Nordic Semiconductor ASA
 *
 * SPDX-License-Identifier: LicenseRef-Nordic-5-Clause
 */

#include "dk_l15_lm20_common.overlay"

/* uart20: keep only the TX pin */
&uart20_default {
	group1 {
		psels = <NRF_PSEL(UART_TX, 1, 4)>;
	};

	/delete-node/ group2;
};

&uart20_sleep {
	group1 {
		psels = <NRF_PSEL(UART_TX, 1, 4)>;
		low-power-enable;
		bias-pull-up;
	};

	/delete-node/ group2;
};
```

## boards/nrf54l15dk_nrf54l15_cpuapp_release.overlay
```dts
/*
 * Copyright (c) 2026 Nordic Semiconductor ASA
 *
 * SPDX-License-Identifier: LicenseRef-Nordic-5-Clause
 */

#include "nrf54l15dk_nrf54l15_cpuapp.overlay"
#include "../app_release.overlay"
```

## boards/nrf54lm20dk_common.overlay
```dts
/*
 * Copyright (c) 2026 Nordic Semiconductor ASA
 *
 * SPDX-License-Identifier: LicenseRef-Nordic-5-Clause
 */

#include "dk_l15_lm20_common.overlay"

/* uart20: keep only the TX pin */
&uart20_default {
	group1 {
		psels = <NRF_PSEL(UART_TX, 1, 16)>;
	};

	/delete-node/ group2;
};

&uart20_sleep {
	group1 {
		psels = <NRF_PSEL(UART_TX, 1, 16)>;
		low-power-enable;
		bias-pull-up;
	};

	/delete-node/ group2;
};
```

## src/main.c
```c
/**
******************************************************************************
* Copyright (c) 2026 Nordic Semiconductor ASA
* Filename : main.c
* Date(DD-MM-YYYY)    Modification    Name
* ----------------    ------------    ----
* 26-10-2026          Created         JF
*******************************************************************************
*/

/* Includes ------------------------------------------------------------------*/
#include <zephyr/kernel.h>
#include <zephyr/logging/log.h>
#include <zephyr/sys/poweroff.h>
#if defined(CONFIG_HWINFO)
#include <zephyr/drivers/hwinfo.h>
#endif
#if defined(CONFIG_APP_GPIO_WAKEUP_ENABLE)
#include <zephyr/drivers/gpio.h>
#endif
#if defined(CONFIG_APP_GRTC_WAKEUP_ENABLE)
#include <zephyr/drivers/timer/nrf_grtc_timer.h>
#endif
#if defined(CONFIG_APP_SYS_CLOCK_DISABLE)
#include <zephyr/drivers/timer/system_timer.h>
#endif
#if defined(CONFIG_APP_USE_RETAINED_MEM)
#include "retained.h"
#endif
#include <zephyr/cache.h>
#include <hal/nrf_memconf.h>

/* Macro----------------------------------------------------------------------*/
#define LOG_MODULE_NAME main
LOG_MODULE_REGISTER(LOG_MODULE_NAME, CONFIG_LOG_DEFAULT_LEVEL);

/*
 * RAM blocks outside the application RAM that stay retained in System OFF.
 *
 * MEMCONF POWER[1].RET bit n controls MEM[n], which is block 32 + n; the reset value is all
 * ones (retained). sys_poweroff() and nrfx_ram_ctrl only touch POWER[0] (the application RAM,
 * 8 x 32 KB on nRF54L15) and bit 0 of POWER[1] (block 32, VPR hibernation RAM), so the blocks
 * below keep drawing retention current in System OFF (about 0.2 uA measured on nRF54L15).
 * Nothing in them has to survive: waking up from System OFF is a reset.
 *
 *   bit  block  nRF54L15 / L10 / L05        nRF54LM20A/B   nRF54LS05A/B
 *   1    33     ICACHE tag + data           ICACHE         ICACHE
 *   2    34     CRACEN PKE code RAM         USBHS RAM      not listed
 *   3    35     CRACEN KeyRAM               not listed     not listed
 */

#if defined(CONFIG_SOC_NRF54L15)
#define POWER1_RET_OFF_MASK \
    (MEMCONF_POWER_RET_MEM1_Msk | MEMCONF_POWER_RET_MEM2_Msk | MEMCONF_POWER_RET_MEM3_Msk)
#elif defined(CONFIG_SOC_NRF54LM20A) || defined(CONFIG_SOC_NRF54LM20B)
#define POWER1_RET_OFF_MASK (MEMCONF_POWER_RET_MEM1_Msk | MEMCONF_POWER_RET_MEM2_Msk)
#elif defined(CONFIG_SOC_NRF54LS05A) || defined(CONFIG_SOC_NRF54LS05B)
#define POWER1_RET_OFF_MASK MEMCONF_POWER_RET_MEM1_Msk
#else
#define POWER1_RET_OFF_MASK 0
#endif

/* Private typedef -----------------------------------------------------------*/

/* Private function prototypes------------------------------------------------*/
static void report_boot(void);
static int prepare_wakeup(void);
#if defined(CONFIG_APP_SYS_CLOCK_DISABLE)
static void system_clock_stop(void);
#endif
static void extra_ram_off(void);

/* Global variables ----------------------------------------------------------*/

/* Private variables ---------------------------------------------------------*/
#if defined(CONFIG_APP_GPIO_WAKEUP_ENABLE)
static const struct gpio_dt_spec sw0 = GPIO_DT_SPEC_GET(DT_ALIAS(sw0), gpios);
#endif

/* Macro ---------------------------------------------------------------------*/

/* Exported functions --------------------------------------------------------*/
/*
 * Enter System OFF on every boot, independent of the reset cause.
 *
 * Wake-up source (Kconfig, snippets pinwake / grtcwake): sw0 level (APP_GPIO_WAKEUP_ENABLE),
 * GRTC timer (APP_GRTC_WAKEUP_ENABLE), or none (default; restart only by pin reset or power
 * cycle).
 *
 * RAM in System OFF (Kconfig, snippet retram): none retained (default), the 4 KB retained_mem
 * region (APP_USE_RETAINED_MEM). The POWER[1] blocks (ICACHE, CRACEN, USBHS) that sys_poweroff()
 * leaves retained are always switched off.
 */
int main(void)
{
    LOG_PRINTK("system_off sample started\n");

    report_boot();

    if (prepare_wakeup() < 0)
    {
        LOG_ERR("Wake-up source setup failed, entering System OFF without it");
    }

    /*
     * Go to System OFF unconditionally; the reset cause is never used as a condition.
     * Without a wake-up source only a reset or a power cycle starts the device again.
     *
     * Order matters. Everything that logs or uses a kernel timeout comes before the system
     * clock is stopped; from there on only register writes are allowed.
     */
#if defined(CONFIG_APP_SYS_CLOCK_DISABLE)
    system_clock_stop();
#endif
    extra_ram_off();
    sys_poweroff();

    return 0;
}

/* Override functions -------------------------------------------------------*/

/* Private Functions ---------------------------------------------------------*/

/**
 * @brief Print the reset cause and the retained boot counters.
 *
 * Informational only, nothing here changes whether the device goes to System OFF.
 */
static void report_boot(void)
{
#if defined(CONFIG_HWINFO)
    uint32_t cause = 0;

    if (hwinfo_get_reset_cause(&cause) == 0)
    {
        LOG_INF("Reset cause 0x%08x", cause);
    }
    else
    {
        LOG_INF("Reset cause not available");
    }
    (void)hwinfo_clear_reset_cause();
#endif

#if defined(CONFIG_APP_USE_RETAINED_MEM)
    /* Invalid (e.g. after a cold power-up) retained data is reset by retained_validate() */
    bool retained_ok = retained_validate();

    retained.boots += 1;
    retained.off_count += 1;
    retained_update();

    LOG_INF("Retained data: %s, boots %u, off count %u", retained_ok ? "valid" : "INVALID",
            retained.boots, retained.off_count);
#endif
}

/**
 * @brief Arm the wake-up sources selected by Kconfig.
 *
 * @return 0 on success, a negative errno otherwise.
 */
static int prepare_wakeup(void)
{
    int rc = 0;

#if defined(CONFIG_APP_GPIO_WAKEUP_ENABLE)
    rc = gpio_pin_configure_dt(&sw0, GPIO_INPUT);
    if (rc < 0)
    {
        LOG_ERR("sw0 configure failed (%d)", rc);
        return rc;
    }

    /*
     * A level-active wake-up fires at once if the button is still held, so wait for the
     * release. A button that stays pressed must not block System OFF for ever: give up after
     * the timeout and enter System OFF without this wake-up source.
     */
    int64_t release_deadline = k_uptime_get() + CONFIG_APP_GPIO_RELEASE_TIMEOUT_MS;

    while (gpio_pin_get_dt(&sw0) > 0)
    {
        if (k_uptime_get() >= release_deadline)
        {
            LOG_WRN("sw0 still pressed after %d ms, sw0 wake-up not armed",
                    CONFIG_APP_GPIO_RELEASE_TIMEOUT_MS);
            return -ETIMEDOUT;
        }
        k_msleep(10);
    }

    rc = gpio_pin_interrupt_configure_dt(&sw0, GPIO_INT_LEVEL_ACTIVE);
    if (rc < 0)
    {
        LOG_ERR("sw0 interrupt configure failed (%d)", rc);
        return rc;
    }
    LOG_INF("Entering System OFF; press sw0 to restart");
#endif

#if defined(CONFIG_APP_GRTC_WAKEUP_ENABLE)
    /* Arm GRTC last, right before entering System OFF; nothing is logged after this. */
    LOG_INF("Entering System OFF; wait %d s to restart", CONFIG_APP_GRTC_WAKEUP_SECONDS);
    rc = z_nrf_grtc_wakeup_prepare((uint64_t)CONFIG_APP_GRTC_WAKEUP_SECONDS * USEC_PER_SEC);
    if (rc < 0)
    {
        LOG_ERR("GRTC wake-up prepare failed (%d)", rc);
        return rc;
    }
#endif

    return rc;
}

#if defined(CONFIG_APP_SYS_CLOCK_DISABLE)
/**
 * @brief Stop the system clock (GRTC and low-frequency clock).
 *
 * Nothing may log or use a kernel timeout after this call.
 */
static void system_clock_stop(void)
{
#if defined(CONFIG_LOG)
    /*
     * The log backend suspends the UART from the system work queue after the last print. If
     * the system clock is stopped first, the scheduler hangs in sys_clock_elapsed() reading the
     * stopped GRTC. Let the pending work finish first.
     */
    k_msleep(100);
#endif
    sys_clock_disable();
}
#endif

/**
 * @brief Switch off the System OFF retention of the POWER[1] RAM blocks that sys_poweroff()
 *        leaves retained (ICACHE, CRACEN, USBHS, see POWER1_RET_OFF_MASK).
 *
 * The application RAM and the retained_mem region are handled by sys_poweroff() itself.
 */
static void extra_ram_off(void)
{
#if defined(CONFIG_SOC_NRF54LS05B) && !defined(CONFIG_APP_USE_RETAINED_MEM)
    /*
     * nrfx_ram_ctrl knows only two 32 KB RAM sections for nRF54LS05 at v3.4.1, but the B
     * variant has a third one (0x20010000-0x20017FFF), so sys_poweroff() leaves its
     * retention on.
     */
    NRF_MEMCONF->POWER[0].RET &= ~MEMCONF_POWER_RET_MEM2_Msk;
#endif
#if POWER1_RET_OFF_MASK
    /* The ICACHE block (bit 1) must not be switched off while the cache is enabled */
    sys_cache_instr_disable();
    NRF_MEMCONF->POWER[1].RET &= ~POWER1_RET_OFF_MASK;
#endif
}

/* Macro ---------------------------------------------------------------------*/
```

## src/retained.c
```c
/*
 * Copyright (c) 2021 Nordic Semiconductor ASA
 *
 * SPDX-License-Identifier: Apache-2.0
 */

#include "retained.h"

#include <stdint.h>
#include <string.h>

#include <zephyr/kernel.h>
#include <zephyr/devicetree.h>
#include <zephyr/drivers/retained_mem.h>
#include <zephyr/sys/byteorder.h>
#include <zephyr/sys/crc.h>

#if DT_NODE_HAS_STATUS_OKAY(DT_ALIAS(retainedmemdevice))
const static struct device *retained_mem_device = DEVICE_DT_GET(DT_ALIAS(retainedmemdevice));
#else
#error "retained_mem region not defined: build with -S retram (it adds snippets/retram/<soc>.overlay)"
#endif

struct retained_data retained;

#define RETAINED_CRC_OFFSET offsetof(struct retained_data, crc)
#define RETAINED_CHECKED_SIZE (RETAINED_CRC_OFFSET + sizeof(retained.crc))

bool retained_validate(void)
{
	int rc;

	rc = retained_mem_read(retained_mem_device, 0, (uint8_t *)&retained, sizeof(retained));
	__ASSERT_NO_MSG(rc == 0);

	/* The residue of a CRC is what you get from the CRC over the
	 * message catenated with its CRC.  This is the post-final-xor
	 * residue for CRC-32 (CRC-32/ISO-HDLC) which Zephyr calls
	 * crc32_ieee.
	 */
	const uint32_t residue = 0x2144df1c;
	uint32_t crc = crc32_ieee((const uint8_t *)&retained,
				  RETAINED_CHECKED_SIZE);
	bool valid = (crc == residue);

	/* If the CRC isn't valid, reset the retained data. */
	if (!valid) {
		memset(&retained, 0, sizeof(retained));
	}

	/* Reset to accrue runtime from this session. */
	retained.uptime_latest = 0;

	return valid;
}

void retained_update(void)
{
	int rc;

	uint64_t now = k_uptime_ticks();

	retained.uptime_sum += (now - retained.uptime_latest);
	retained.uptime_latest = now;

	uint32_t crc = crc32_ieee((const uint8_t *)&retained,
				  RETAINED_CRC_OFFSET);

	retained.crc = sys_cpu_to_le32(crc);

	rc = retained_mem_write(retained_mem_device, 0, (uint8_t *)&retained, sizeof(retained));
	__ASSERT_NO_MSG(rc == 0);
}
```
